## hi3322/Kconfig.liteos_m.series
```kconfig
config SOC_SERIES_HI3322
    bool "HiSilicon HI3322 Series"
    depends on PLATFORM_HI3322
    select ARCH_RISCV32
    select SOC_COMPANY_HISILICON
    help
        Enable support for HiSilicon HI3322 Series

config SOC_COMPANY
    string
    default "hisilicon" if PLATFORM_HI3322
```

## hi3322/Kconfig.liteos_m.soc
```kconfig
choice
    prompt "HI3322 series SoC"
    depends on SOC_SERIES_HI3322

config SOC_HI3322V100
    bool "SoC HI3322V100"
    default y

endchoice
```
